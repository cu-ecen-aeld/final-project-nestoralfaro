## openspot/Config.in
```kconfig
menu "OpenSpot Packages"

source "$BR2_EXTERNAL_openspot_PATH/package/main/Config.in"

endmenu
```

## openspot/package/main/Config.in
```kconfig
config BR2_PACKAGE_MAIN
    bool "main"
    help
      Main C++ source that for now only prints when invoked.
```
